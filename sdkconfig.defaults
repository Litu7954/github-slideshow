## sdkconfig.defaults
```kconfig
# ESP-IDF SDK Configuration defaults
CONFIG_FREERTOS_HZ=1000
CONFIG_ESP_TASK_WDT_TIMEOUT_S=30
CONFIG_TWAI_ISR_IN_IRAM=y
CONFIG_ESP_SYSTEM_EVENT_TASK_STACK_SIZE=4096

# Enable CAN (TWAI) driver
CONFIG_TWAI_ERRATA_FIX_BUS_OFF_REC=y
CONFIG_TWAI_ERRATA_FIX_TX_INTR_LOST=y
CONFIG_TWAI_ERRATA_FIX_RX_FRAME_INVALID=y
CONFIG_TWAI_ERRATA_FIX_RX_FIFO_CORRUPT=y

# WiFi
CONFIG_ESP_WIFI_SOFTAP_SUPPORT=y
CONFIG_HTTPD_MAX_REQ_HDR_LEN=1024
CONFIG_HTTPD_MAX_URI_LEN=512

# SPI
CONFIG_SPI_MASTER_IN_IRAM=y
```
